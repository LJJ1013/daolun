#define SSID        "HA" //改为你的热点名称, 不要有中文
#define PASSWORD    "5a28a4da9911"//改为你的WiFi密码Wi-Fi密码
#define DEVICEID    "577972912" //OneNet上的设备ID
String apiKey = "SCtPXHLtTOegm8irvJyd8JMzL88=  ";//与你的设备绑定的APIKey

#include <Wire.h>                                  //调用库  
#include <ESP8266.h>
#include <I2Cdev.h>                                //调用库  
#include <Microduino_Audio.h>
#include <Microduino_Key.h>
#include <U8glib.h>
const unsigned char PROGMEM shi[] = {
/*--  调入了一幅图像：C:\Users\86186\Desktop\妈呀.bmp  --*/
/*--  宽度x高度=128x66  --*/
0x00,0x00,0x00,0x00,0x00,0x00,0x00,0x00,0x00,0x00,0x00,0x00,0x00,0x00,0x00,0x00,
0x00,0x00,0x00,0x00,0x00,0x00,0x00,0x00,0x00,0x00,0x00,0x00,0x00,0x00,0x00,0x00,
0x00,0x00,0x00,0x00,0x00,0x00,0x00,0x00,0x00,0x00,0x00,0x00,0x00,0x00,0x00,0x00,
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0x00,0x00,0x00,0x00,0x00,0x00,0x00,0x00,0x00,0x00,0x00,0x00,0x00,0x00,0x00,0x00


};

#define INTERVAL_LCD             10             //定义OLED刷新时间间隔  
unsigned long lcd_time = millis();                 //OLED刷新时间计时器
U8GLIB_SSD1306_128X64 u8g(U8G_I2C_OPT_NONE);     //设置OLED型号  

/***/
#define HOST_NAME   "api.heclouds.com"
#define HOST_PORT   (80)
#define INTERVAL_SENSOR   5000             //定义传感器采样时间间隔  597000
#define INTERVAL_NET      5000             //定义发送时间
//传感器部分================================   

/*******温湿度*******/
#include <Microduino_SHT2x.h>
/*******光照*******/
#define  sensorPin_1  A0
#define IDLE_TIMEOUT_MS  3000      // Amount of time to wait (in milliseconds) with no data 
                                   // received before closing the connection.  If you know the server
                                   // you're accessing is quick to respond, you can reduce this value.

//WEBSITE     
char buf[10];

#define INTERVAL_sensor 2000
unsigned long sensorlastTime = millis();

float tempOLED, humiOLED, lightnessOLED;

#define INTERVAL_OLED 1000

String mCottenData;
String jsonToSend;

//3,传感器值的设置 
float sensor_tem, sensor_hum, sensor_lux;                    //传感器温度、湿度、光照   
char  sensor_tem_c[7], sensor_hum_c[7], sensor_lux_c[7] ;    //换成char数组传输
#include <SoftwareSerial.h>
#define EspSerial mySerial
#define UARTSPEED  9600
SoftwareSerial mySerial(2, 3); /* RX:D3, TX:D2 */
ESP8266 wifi(&EspSerial);
//ESP8266 wifi(Serial1);                                      //定义一个ESP8266（wifi）的对象
unsigned long net_time1 = millis();                          //数据上传服务器时间
unsigned long sensor_time = millis();                        //传感器采样时间计时器

//int SensorData;                                   //用于存储传感器数据
String postString;                                //用于存储发送数据的字符串
//String jsonToSend;                                //用于存储发送的json格式参数

Tem_Hum_S2 TempMonitor;
AnalogKey keyA6[3] {(A6), (A6), (A6)};

//Core UART Port: [SoftSerial] [D2,D3]
#if defined (__AVR_ATmega168__) || defined (__AVR_ATmega328__) || defined (__AVR_ATmega328P__) || defined(__AVR_ATmega32U4__)
#include <SoftwareSerial.h>
SoftwareSerial AudioSerial(2, 3); /* RX:D2, TX:D3 */
Audio audio(&AudioSerial);
#endif

//Core+ UART Port: [Serial1] [D2,D3]
#if defined(__AVR_ATmega1284P__) || defined (__AVR_ATmega644P__) || defined(__AVR_ATmega128RFA1__)
#define AudioSerial Serial1
Audio audio(&AudioSerial);
#endif

//CoreESP UART Port: [RX,TX]
#if defined(ESP32)
HardwareSerial AudioSerial(1);
Audio audio(&AudioSerial, D2, D3);
#endif

uint8_t musicVol = 20;             //初始音量20
uint8_t musicMode = MODE_ALL;      //初始播放模式--全部循环
boolean music_status = false;      //歌曲播放状态
uint16_t fileNum = 0;               //查询当前播放歌曲编号
uint16_t fileNumCache = 0;          //播放歌曲编号缓存
uint16_t totalNum = 0;              //歌曲总数量
uint16_t totalTime = 0;             //当前播放歌曲总时间
uint16_t playTime = 0;              //当前播放歌曲播放时间

uint32_t time1 = 0;

String nameCache = "";
int a=10;
int b=0;
int c=0;
int d=0;
int e=0;
int g=0;
int f=0;
int i=0;

void setup(void)     //初始化函数  
{       
  //初始化串口波特率  
    Wire.begin();
    Serial.begin(9600);
    while (!Serial); // wait for Leonardo enumeration, others continue immediately
    Serial.print(F("setup begin\r\n"));
    delay(100);
    pinMode(sensorPin_1, INPUT);
  Serial.println("Hello");   //短按

  keyA6[0].begin();
  keyA6[1].begin();
  keyA6[2].begin();

  Serial.println("init Audio");   //短按
  audio.begin(DEVICE_TF, musicMode, musicVol);   //播放控制类初始化，设置播放设备为TF卡

  delay(1000);
  totalNum = audio.queryTF();         //读取TF卡总文件数量
  audio.chooseMusic(1);                  //默认从第一首曲目开始
  audio.pauseMusic();                    //暂停
  Serial.println("Done");   //短按

  WifiInit(EspSerial, UARTSPEED);

  Serial.print(F("FW Version:"));
  Serial.println(wifi.getVersion().c_str());

  if (wifi.setOprToStationSoftAP()) {
    Serial.print(F("to station + softap ok\r\n"));
  } else {
    Serial.print(F("to station + softap err\r\n"));
  }

  if (wifi.joinAP(SSID, PASSWORD)) {
    Serial.print(F("Join AP success\r\n"));

    Serial.print(F("IP:"));
    Serial.println( wifi.getLocalIP().c_str());
  } else {
    Serial.print(F("Join AP failure\r\n"));
  }

  if (wifi.disableMUX()) {
    Serial.print(F("single ok\r\n"));
  } else {
    Serial.print(F("single err\r\n"));
  }

  Serial.print(F("setup end\r\n"));
    
  
}
void loop(void)     //循环函数  
{   
  u8g.firstPage();
  do {
   a=a-1;
   u8g.drawBitmapP(a, b, 16, 64, shi);
   
   
   
  }while (u8g.nextPage());

 
  
  if (sensor_time > millis())  sensor_time = millis();  
    
  if(millis() - sensor_time > INTERVAL_SENSOR)              //传感器采样时间间隔  
  {  
    getSensorData();                                        //读串口中的传感器数据
    sensor_time = millis();
  }  

    
  if (net_time1 > millis())  net_time1 = millis();
  
  if (millis() - net_time1 > INTERVAL_NET)                  //发送数据时间间隔
  {                
    updateSensorData();                                     //将数据上传到服务器的函数
    net_time1 = millis();
  }
   
}

void getSensorData(){  
    sensor_tem = TempMonitor.getTemperature();  
    sensor_hum = TempMonitor.getHumidity();   
    //获取光照
    sensor_lux = analogRead(A0);    
    delay(1000);
    dtostrf(sensor_tem, 2, 1, sensor_tem_c);
    dtostrf(sensor_hum, 2, 1, sensor_hum_c);
    dtostrf(sensor_lux, 3, 1, sensor_lux_c);
}
void updateSensorData() {
  if (wifi.createTCP(HOST_NAME, HOST_PORT)) { //建立TCP连接，如果失败，不能发送该数据
    Serial.print("create tcp ok\r\n");

jsonToSend="{\"Temperature\":";
    dtostrf(sensor_tem,1,2,buf);
    jsonToSend+="\""+String(buf)+"\"";
    jsonToSend+=",\"Humidity\":";
    dtostrf(sensor_hum,1,2,buf);
    jsonToSend+="\""+String(buf)+"\"";
    jsonToSend+=",\"Light\":";
    dtostrf(sensor_lux,1,2,buf);
    jsonToSend+="\""+String(buf)+"\"";
    jsonToSend+="}";



    postString="POST /devices/";
    postString+=DEVICEID;
    postString+="/datapoints?type=3 HTTP/1.1";
    postString+="\r\n";
    postString+="api-key:";
    postString+=apiKey;
    postString+="\r\n";
    postString+="Host:api.heclouds.com\r\n";
    postString+="Connection:close\r\n";
    postString+="Content-Length:";
    postString+=jsonToSend.length();
    postString+="\r\n";
    postString+="\r\n";
    postString+=jsonToSend;
    postString+="\r\n";
    postString+="\r\n";
    postString+="\r\n";

  const char *postArray = postString.c_str();                 //将str转化为char数组
  Serial.println(postArray);
  wifi.send((const uint8_t*)postArray, strlen(postArray));    //send发送命令，参数必须是这两种格式，尤其是(const uint8_t*)
  Serial.println("send success");   
     if (wifi.releaseTCP()) {                                 //释放TCP连接
        Serial.print("release tcp ok\r\n");
        } 
     else {
        Serial.print("release tcp err\r\n");
        }
      postArray = NULL;                                       //清空数组，等待下次传输数据
  
  } else {
    Serial.print("create tcp err\r\n");
  }
  switch (keyA6[0].readEvent(140 - 30, 140 + 30)) {
    case SHORT_PRESS:
      audio.prevMusic();
      Serial.println("prev");   //短按
      break;
    case LONG_PRESS:
      audio.volumeUp();
      Serial.println("volUp");    //长按
      delay(500);
      break;
  }

  switch (keyA6[1].readEvent(80 - 30, 80 + 30)) {
    case SHORT_PRESS:
      audio.nextMusic();
      Serial.println("next");   //短按
      break;
    case LONG_PRESS:
      audio.volumeDown();
      Serial.println("volDown");    //长按
      delay(500);
      break;
  }

  switch (keyA6[2].readEvent(0, 30)) {
    case SHORT_PRESS:
      music_status = !music_status; //播放或暂停
      if (music_status) {
        audio.playMusic();
        Serial.println("play");
      }
      else {
        audio.pauseMusic();
        Serial.println("pause");
      };
      break;
  }

  if (millis() - time1 > 1000) {  
    time1 = millis();

    fileNum = audio.queryTFFile();        //查询当前播放歌曲的编号
    if (fileNum != fileNumCache) {      //发现播放歌曲更换
      fileNumCache = fileNum;
      nameCache = audio.queryName();    //查询当前播放歌曲名称
      totalTime = audio.queryTotalTime();     //查询当前播放歌曲总时间
    }
    playTime = audio.queryPlayTime();       //查询当前播放歌曲播放时间
    Serial.print("FileNum:");
    Serial.print(fileNum);
    Serial.print(", FileName:");
    Serial.print(nameCache);
    Serial.print(", TotleTime:");
    Serial.print(totalTime);
    Serial.print(", PlayTime:");
    Serial.println(playTime);
  }

  delay(10);
 
}
